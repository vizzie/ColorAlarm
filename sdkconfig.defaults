## sdkconfig.defaults
```kconfig
# ---- Target ----
CONFIG_IDF_TARGET="esp32"
CONFIG_IDF_TARGET_ESP32=y

# ---- Wi-Fi / Netif ----
CONFIG_ESP_NETIF_IP_LOST_TIMER_INTERVAL=120
CONFIG_WIFI_PROV_AUTOSTOP_TIMEOUT=0

# ---- HTTP Server ----
CONFIG_HTTPD_MAX_REQ_HDR_LEN=2048
CONFIG_HTTPD_MAX_URI_LEN=1024

# ---- SNTP (LWIP) ----
CONFIG_LWIP_SNTP=y
CONFIG_LWIP_SNTP_MAX_SERVERS=1
CONFIG_LWIP_SNTP_UPDATE_DELAY=3600000
CONFIG_LWIP_DHCP_DOES_ARP_CHECK=y

# ---- RMT Driver ----
CONFIG_RMT_SUPPRESS_DEPRECATE_WARN=y

# ---- NVS ----
CONFIG_PARTITION_TABLE_SINGLE_APP=y
CONFIG_PARTITION_TABLE_FILENAME="partitions_singleapp.csv"

# ---- Logging ----
CONFIG_LOG_DEFAULT_LEVEL_INFO=y
CONFIG_LOG_COLORS=y
```
